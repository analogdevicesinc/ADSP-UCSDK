## meta-adi-sc5xx-ucsdk/conf/layer.conf
```bitbake
# We have a conf and classes directory, add to BBPATH
BBPATH .= ":${LAYERDIR}"

# We have recipes-* directories, add to BBFILES
BBFILES += " \
    ${LAYERDIR}/recipes-*/*/*.bb \
    ${LAYERDIR}/recipes-*/*/*.bbappend \
"

BBFILE_COLLECTIONS += "meta-adi-sc5xx-ucsdk"
BBFILE_PATTERN_meta-adi-sc5xx-ucsdk = "^${LAYERDIR}/"
BBFILE_PRIORITY_meta-adi-sc5xx-ucsdk = "12"

LAYERDEPENDS_meta-adi-sc5xx-ucsdk = "adsp-sc5xx"
LAYERSERIES_COMPAT_meta-adi-sc5xx-ucsdk = "thud dunfell"
```
